#include "ssd1306.h"
#include <string.h>

// =============================================================================
// 5x8 pixel font — ASCII 0x20 (space) to 0x7E (~)
// Each entry is 5 bytes: one byte per column, bit 0 = top pixel.
// =============================================================================
static const uint8_t s_font5x8[][5] = {
    { 0x00, 0x00, 0x00, 0x00, 0x00 }, // 0x20  ' '
    { 0x00, 0x00, 0x5F, 0x00, 0x00 }, // 0x21  '!'
    { 0x00, 0x07, 0x00, 0x07, 0x00 }, // 0x22  '"'
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    { 0x10, 0x08, 0x08, 0x10, 0x08 }, // 0x7E  '~'
};

// =============================================================================
// Internal state
// =============================================================================
static i2c_port_t s_port;
static uint8_t    s_addr;
static uint8_t    s_fb[SSD1306_PAGES][SSD1306_WIDTH];

// =============================================================================
// Low-level I2C helpers
// =============================================================================
static void write_cmd(uint8_t cmd)
{
    uint8_t buf[2] = { 0x00, cmd };
    i2c_master_write_to_device(s_port, s_addr, buf, sizeof(buf),
                               pdMS_TO_TICKS(100));
}

static void write_cmd2(uint8_t c1, uint8_t c2)
{
    uint8_t buf[3] = { 0x00, c1, c2 };
    i2c_master_write_to_device(s_port, s_addr, buf, sizeof(buf),
                               pdMS_TO_TICKS(100));
}

static void write_data(const uint8_t *data, size_t len)
{
    // Stack buffer: 1 control byte + up to SSD1306_WIDTH data bytes
    uint8_t buf[1 + SSD1306_WIDTH];
    if (len > SSD1306_WIDTH) len = SSD1306_WIDTH;
    buf[0] = 0x40;
    memcpy(&buf[1], data, len);
    i2c_master_write_to_device(s_port, s_addr, buf, len + 1,
                               pdMS_TO_TICKS(100));
}

// =============================================================================
// Public API
// =============================================================================
void ssd1306_init(i2c_port_t port, uint8_t addr)
{
    s_port = port;
    s_addr = addr;
    memset(s_fb, 0, sizeof(s_fb));

    write_cmd(0xAE);                          // Display OFF
    write_cmd2(0xD5, 0x80);                   // Clock divide / oscillator
    write_cmd2(0xA8, SSD1306_HEIGHT - 1);     // Multiplex ratio (39 for 40px)
    write_cmd2(0xD3, 0x00);                   // Display offset: 0
    write_cmd(0x40);                          // Start line: 0
    write_cmd2(0x8D, 0x14);                   // Charge pump: enabled
    write_cmd2(0x20, 0x00);                   // Horizontal addressing mode
    write_cmd(0xA1);                          // Segment remap (col 127 -> SEG0)
    write_cmd(0xC8);                          // COM scan direction: remapped
    write_cmd2(0xDA, 0x12);                   // COM pins: alternative config
    write_cmd2(0x81, 0xCF);                   // Contrast
    write_cmd2(0xD9, 0xF1);                   // Pre-charge period
    write_cmd2(0xDB, 0x40);                   // VCOMH deselect level
    write_cmd(0xA4);                          // RAM content -> display
    write_cmd(0xA6);                          // Normal (non-inverted) display
    write_cmd(0xAF);                          // Display ON
}

void ssd1306_clear(void)
{
    memset(s_fb, 0, sizeof(s_fb));
}

void ssd1306_write_string(uint8_t col, uint8_t page, const char *str)
{
    if (page >= SSD1306_PAGES) return;

    while (*str && col < SSD1306_WIDTH) {
        uint8_t c = (uint8_t)*str++;
        // Clamp to printable range
        if (c < 0x20 || c > 0x7E) c = 0x20;

        const uint8_t *glyph = s_font5x8[c - 0x20];
        for (int i = 0; i < 5 && col < SSD1306_WIDTH; i++, col++) {
            s_fb[page][col] = glyph[i];
        }
        // 1-pixel horizontal gap between characters
        if (col < SSD1306_WIDTH) {
            s_fb[page][col++] = 0x00;
        }
    }
}

void ssd1306_update(void)
{
    // Column window: offset into the 128-column controller
    write_cmd(0x21);
    write_cmd(SSD1306_COL_OFFSET);
    write_cmd(SSD1306_COL_OFFSET + SSD1306_WIDTH - 1);

    // Page window: 0 to PAGES-1
    write_cmd(0x22);
    write_cmd(0x00);
    write_cmd(SSD1306_PAGES - 1);

    // Push each page row
    for (int p = 0; p < SSD1306_PAGES; p++) {
        write_data(s_fb[p], SSD1306_WIDTH);
    }
}
